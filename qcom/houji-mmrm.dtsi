// SPDX-License-Identifier: GPL-2.0-only
// Clock admission-control data from CN OS3.0.307.0.WNCCNXM, all four DTBs.

&soc {
	mmrm: qcom,mmrm {
		mmrm-client-info =
			<0x1 0x45 0x18612f6 0x4d1ec 0x1>,
			<0x1 0x49 0x18612f6 0x4d1ec 0x1>,
			<0x1 0x4d 0x18612f6 0x4d1ec 0x1>,
			<0x1 0x33 0x205ec7 0xdb65 0x3>,
			<0x1 0x8e 0x16e2329 0x55fc7 0x1>,
			<0x1 0x92 0x16e2329 0x55fc7 0x1>,
			<0x1 0x96 0x16e2329 0x55fc7 0x1>,
			<0x1 0x58 0x48eeb49 0xd570b 0x1>,
			<0x1 0x2 0x2617c8d 0x10709 0x1>,
			<0x1 0x52 0x144a28 0x7206 0x2>,
			<0x1 0x5f 0xbe037 0x47af 0x4>,
			<0x1 0x7 0x7a5b94 0x26a3e 0x1>,
			<0x1 0x55 0x3a42b 0x3b99 0x2>,
			<0x1 0x43 0x505bc 0x1da6 0x1>,
			<0x1 0x1e 0x4ccd 0x81df 0xa>,
			<0x1 0x23 0x199a 0x5 0x1>,
			<0x1 0x25 0x199a 0x5 0x1>,
			<0x1 0x27 0x199a 0x5 0x1>,
			<0x1 0x29 0x199a 0x5 0x1>,
			<0x1 0x2b 0x199a 0x5 0x1>,
			<0x1 0x2d 0x199a 0x5 0x1>,
			<0x1 0x2f 0x199a 0x5 0x1>,
			<0x1 0x31 0x199a 0x5 0x1>,
			<0x1 0xb 0x0 0x18d 0x1>,
			<0x1 0xd 0x0 0x18d 0x1>,
			<0x1 0xf 0x0 0x18d 0x1>,
			<0x1 0x9b 0xe667 0x2d92 0x1>,
			<0x1 0x3f 0x8000 0x195c 0x1>,
			<0x1 0x21 0x148d6 0x787 0x1>,
			<0x2 0xa 0x85a51ec 0x13947b 0x1>,
			<0x3 0x3e 0xd9cccd 0x34290 0x1>,
			<0x3 0x10 0xacccd 0xdf4 0x1>,
			<0x4 0x3 0x271bd71 0x1d63d8 0x1>;
		scaling-fact-leak = <0xcb0e6 0xd978e 0xe51aa 0xfa7af 0x13126f>;
		scaling-fact-dyn = <0xc6a8 0xd99a 0xe8f6 0x1051f 0x14b44>;
		mm-rail-fact-volt = <0x9811 0x9eb9 0xa3d8 0xaccd 0xc0c5>;
		mm-rail-corners = "lowsvs", "svs", "svsl1", "nom", "turbo";
		mmrm-peak-threshold = <0x2710>;
		status = "okay";
		compatible = "qcom,msm-mmrm", "qcom,pineapple-mmrm";
	};
};
